## CMakeLists.txt
```
#
# Copyright (c) 2020 Nordic Semiconductor
#
# SPDX-License-Identifier: LicenseRef-Nordic-5-Clause
#

cmake_minimum_required(VERSION 3.20.0)

find_package(Zephyr REQUIRED HINTS $ENV{ZEPHYR_BASE})
project(udp)

# NORDIC SDK APP START
target_sources(app PRIVATE src/main.c)
target_sources(app PRIVATE src/ui_rgb_control.c)
target_sources(app PRIVATE src/ui_buzzer_control.c)
target_sources(app PRIVATE src/user_shell_cmd.c)
# NORDIC SDK APP END

zephyr_include_directories(src)

zephyr_library_include_directories(
	src/ui
	src
	)

add_subdirectory(src/ui)
```

## Kconfig
```
#
# Copyright (c) 2020 Nordic Semiconductor ASA
#
# SPDX-License-Identifier: LicenseRef-Nordic-5-Clause
#

menu "Thingy 91 sample"

rsource "src/ui/Kconfig"
rsource "src/ui/Kconfig.ui_led"
	
menu "UDP Sample Settings"

config UDP_DATA_UPLOAD_SIZE_BYTES
	int "Number of bytes transmitted to the server"
	default 10

config UDP_DATA_UPLOAD_FREQUENCY_SECONDS
	int "How often data is transmitted to the server"
	default 900

config UDP_SERVER_ADDRESS_STATIC
	string "UDP server IP address"
	default "8.8.8.8"

config UDP_SERVER_PORT
	int "UDP server port number"
	default "2469"

config UDP_PSM_ENABLE
	bool "Enable LTE Power Saving Mode"
	default y

config UDP_EDRX_ENABLE
	bool "Enable LTE enhanced Discontinuous Reception"

config UDP_RAI_ENABLE
	bool "Enable LTE Release Assistance Indication"

endmenu

module = UDP
module-str = UDP sample
source "${ZEPHYR_BASE}/subsys/logging/Kconfig.template.log_config"

endmenu 

menu "Zephyr Kernel"
source "Kconfig.zephyr"
endmenu
```

## prj.conf
```kconfig
#
# Copyright (c) 2020 Nordic Semiconductor ASA
#
# SPDX-License-Identifier: LicenseRef-Nordic-5-Clause
#

# General config
CONFIG_NEWLIB_LIBC=y
CONFIG_NEWLIB_LIBC_FLOAT_PRINTF=y
CONFIG_NCS_SAMPLES_DEFAULTS=y
#CONFIG_SERIAL=n

# Network
CONFIG_NETWORKING=y
CONFIG_NET_NATIVE=n
CONFIG_NET_SOCKETS=y
CONFIG_NET_SOCKETS_OFFLOAD=y

# LTE link control
CONFIG_LTE_LINK_CONTROL=y
CONFIG_LTE_AUTO_INIT_AND_CONNECT=n

# Modem library
CONFIG_NRF_MODEM_LIB=y

# Heap and stacks
CONFIG_HEAP_MEM_POOL_SIZE=1024
CONFIG_MAIN_STACK_SIZE=4096
CONFIG_SYSTEM_WORKQUEUE_STACK_SIZE=2048

# LTE parameters
## Network Mode / LTE category
CONFIG_LTE_NETWORK_MODE_NBIOT_GPS=y

## PSM
CONFIG_UDP_PSM_ENABLE=y
CONFIG_LTE_PSM_REQ_RPTAU="00100001"
CONFIG_LTE_PSM_REQ_RAT="00000000"

## eDRX
CONFIG_UDP_EDRX_ENABLE=n
CONFIG_LTE_EDRX_REQ_VALUE_LTE_M="1001"

## RAI
CONFIG_UDP_RAI_ENABLE=n
CONFIG_LTE_RAI_REQ_VALUE="4"

######## victor add ########

CONFIG_LOG_MODE_DEFERRED=y
CONFIG_LOG_BACKEND_UART=y

CONFIG_UDP_SERVER_ADDRESS_STATIC="115.29.200.85"
CONFIG_UDP_SERVER_PORT=20001
CONFIG_UDP_DATA_UPLOAD_SIZE_BYTES=20

#CONFIG_UI_SENSE_LED=y
CONFIG_UI_LED=y
CONFIG_UI_LED_USE_PWM=y

CONFIG_UI_BUZZER=y

CONFIG_DK_LIBRARY=y


CONFIG_SHELL=y
#CONFIG_NRF_CLOUD_CLIENT_ID_SRC_INTERNAL_UUID=y
#CONFIG_MODEM_JWT=y

#CONFIG_MULTICELL_LOCATION_SERVICE_NRF_CLOUD=y
#CONFIG_NRF_CLOUD_REST=y
```

## src/main.c
```c
/*
 * Copyright (c) 2020 Nordic Semiconductor ASA
 *
 * SPDX-License-Identifier: LicenseRef-Nordic-5-Clause
 */

#include <zephyr/kernel.h>
#include <stdio.h>
#include <modem/lte_lc.h>
#include <zephyr/net/socket.h>
#include <nrf_modem_gnss.h>
#include "ui_led.h"
#include "ui_buzzer.h"
#include <dk_buttons_and_leds.h>
#include "ui_rgb_control.h"

LOG_MODULE_REGISTER(main, 3);

#define UDP_IP_HEADER_SIZE 28

static int client_fd;
static struct sockaddr_storage host_addr;
static struct k_work_delayable server_transmission_work;

K_SEM_DEFINE(lte_connected, 0, 1);


/*victor add variables*/
#define USER_WORK_Q_STACK_SIZE 4096
#define USER_WORK_Q_PRIORITY 5
K_THREAD_STACK_DEFINE(user_work_q_stack, USER_WORK_Q_STACK_SIZE);
static struct k_work_q user_work_q;

/*gnss*/
static struct k_work_delayable gnss_data_process_dwork;

static struct k_work_delayable multi_cell_request_dwork;

static K_SEM_DEFINE(pvt_data_sem, 0, 1);
static struct nrf_modem_gnss_pvt_data_frame last_pvt;

/*ui led*/
#define BRIGHTNESS_MAX   100U

static bool state[NUM_LEDS];
static uint8_t brightness_val[NUM_LEDS];
static uint8_t colour_val[NUM_LEDS];

/*ui buzzer*/
#define INTENSITY_START_VAL 100.0
#define FREQUENCY_START_VAL 440U

/* test */
static struct k_work_delayable ui_test;


static void server_transmission_work_fn(struct k_work *work)
{
	int err;
	char buffer[CONFIG_UDP_DATA_UPLOAD_SIZE_BYTES] = {"hello from thingy\0"};

	printk("Transmitting UDP/IP payload of %d bytes to the ",
	       CONFIG_UDP_DATA_UPLOAD_SIZE_BYTES + UDP_IP_HEADER_SIZE);
	printk("IP address %s, port number %d\n",
	       CONFIG_UDP_SERVER_ADDRESS_STATIC,
	       CONFIG_UDP_SERVER_PORT);

	err = send(client_fd, buffer, sizeof(buffer), 0);
	if (err < 0) {
		printk("Failed to transmit UDP packet, %d\n", errno);
		return;
	}

	k_work_schedule(&server_transmission_work,
			K_SECONDS(CONFIG_UDP_DATA_UPLOAD_FREQUENCY_SECONDS));
}

static void work_init(void)
{
	k_work_init_delayable(&server_transmission_work,
			      server_transmission_work_fn);
}

#if defined(CONFIG_NRF_MODEM_LIB)
static void lte_handler(const struct lte_lc_evt *const evt)
{
	switch (evt->type) {
	case LTE_LC_EVT_NW_REG_STATUS:
		if ((evt->nw_reg_status != LTE_LC_NW_REG_REGISTERED_HOME) &&
		     (evt->nw_reg_status != LTE_LC_NW_REG_REGISTERED_ROAMING)) {
			break;
		}

		printk("Network registration status: %s\n",
			evt->nw_reg_status == LTE_LC_NW_REG_REGISTERED_HOME ?
			"Connected - home network" : "Connected - roaming\n");
		k_sem_give(&lte_connected);
		break;
	case LTE_LC_EVT_PSM_UPDATE:
		printk("PSM parameter update: TAU: %d, Active time: %d\n",
			evt->psm_cfg.tau, evt->psm_cfg.active_time);
		break;
	case LTE_LC_EVT_EDRX_UPDATE: {
		char log_buf[60];
		ssize_t len;

		len = snprintf(log_buf, sizeof(log_buf),
			       "eDRX parameter update: eDRX: %f, PTW: %f\n",
			       evt->edrx_cfg.edrx, evt->edrx_cfg.ptw);
		if (len > 0) {
			printk("%s\n", log_buf);
		}
		break;
	}
	case LTE_LC_EVT_RRC_UPDATE:
		printk("RRC mode: %s\n",
			evt->rrc_mode == LTE_LC_RRC_MODE_CONNECTED ?
			"Connected" : "Idle\n");
		break;
	case LTE_LC_EVT_CELL_UPDATE:
		printk("LTE cell changed: Cell ID: %d, Tracking area: %d\n",
		       evt->cell.id, evt->cell.tac);
		break;
	default:
		break;
	}
}

static int configure_low_power(void)
{
	int err;

#if defined(CONFIG_UDP_PSM_ENABLE)
	/** Power Saving Mode */
	err = lte_lc_psm_req(true);
	if (err) {
		printk("lte_lc_psm_req, error: %d\n", err);
	}
#else
	err = lte_lc_psm_req(false);
	if (err) {
		printk("lte_lc_psm_req, error: %d\n", err);
	}
#endif

#if defined(CONFIG_UDP_EDRX_ENABLE)
	/** enhanced Discontinuous Reception */
	err = lte_lc_edrx_req(true);
	if (err) {
		printk("lte_lc_edrx_req, error: %d\n", err);
	}
#else
	err = lte_lc_edrx_req(false);
	if (err) {
		printk("lte_lc_edrx_req, error: %d\n", err);
	}
#endif

#if defined(CONFIG_UDP_RAI_ENABLE)
	/** Release Assistance Indication  */
	err = lte_lc_rai_req(true);
	if (err) {
		printk("lte_lc_rai_req, error: %d\n", err);
	}
#endif

	return err;
}

static void modem_init(void)
{
	int err;
	uint8_t at_buf[64];

	if (IS_ENABLED(CONFIG_LTE_AUTO_INIT_AND_CONNECT)) {
		/* Do nothing, modem is already configured and LTE connected. */
	} else {
		err = lte_lc_init();
		if (err) {
			printk("Modem initialization failed, error: %d\n", err);
			return;
		}
	}

	nrf_modem_at_cmd(at_buf, sizeof(at_buf), "AT%%XEPCO=0");
	printk("AT%%XEPCO: %s\n", at_buf);

	nrf_modem_at_cmd(at_buf, sizeof(at_buf), "AT+CGMR");
	printk("Current modem firmware version: %s\n", at_buf);	
}

static void modem_connect(void)
{
	int err;

	if (IS_ENABLED(CONFIG_LTE_AUTO_INIT_AND_CONNECT)) {
		/* Do nothing, modem is already configured and LTE connected. */
	} else {
		err = lte_lc_connect_async(lte_handler);
		if (err) {
			printk("Connecting to LTE network failed, error: %d\n",
			       err);
			return;
		}
	}
}
#endif

static void server_disconnect(void)
{
	(void)close(client_fd);
}

static int server_init(void)
{
	struct sockaddr_in *server4 = ((struct sockaddr_in *)&host_addr);

	server4->sin_family = AF_INET;
	server4->sin_port = htons(CONFIG_UDP_SERVER_PORT);

	inet_pton(AF_INET, CONFIG_UDP_SERVER_ADDRESS_STATIC,
		  &server4->sin_addr);

	return 0;
}

static int server_connect(void)
{
	int err;

	client_fd = socket(AF_INET, SOCK_DGRAM, IPPROTO_UDP);
	if (client_fd < 0) {
		printk("Failed to create UDP socket: %d\n", errno);
		err = -errno;
		goto error;
	}

	err = connect(client_fd, (struct sockaddr *)&host_addr,
		      sizeof(struct sockaddr_in));
	if (err < 0) {
		printk("Connect failed : %d\n", errno);
		goto error;
	}

	return 0;

error:
	server_disconnect();

	return err;
}




/*victor add functions */

static void gnss_data_process_dwork_fn(struct k_work *work)
{
	printf("\033[1;1H");
	printf("\033[2J");
	//print_satellite_stats(&last_pvt);
	if (last_pvt.flags & NRF_MODEM_GNSS_PVT_FLAG_FIX_VALID) {
		//print_fix_data(&last_pvt);
	}
}

/* test function*/
static void ui_test_fn(struct k_work *work)
{
	int ret;
	struct ui_rgb_control_color rgb_color;
	struct ui_rgb_control_effect rgb_effect;

	rgb_color.red = 0;
	rgb_color.green = 255;
	rgb_color.blue = 0;

	rgb_effect.type = UI_RGB_CONTROL_TYPE_BLINKY;
	rgb_effect.interval = 2;
	rgb_effect.duty = 50;
	rgb_effect.duration = 120;
	
	ret = ui_rgb_control_set(rgb_color,rgb_effect);
	if(ret) {
		LOG_ERR("ui_rgb_control_set error");
	}
}

void user_work_init(void)
{
        k_work_queue_init(&user_work_q);
        k_work_queue_start(&user_work_q, user_work_q_stack,
                           K_THREAD_STACK_SIZEOF(user_work_q_stack), USER_WORK_Q_PRIORITY,
                           NULL);

        k_work_init_delayable(&gnss_data_process_dwork, gnss_data_process_dwork_fn);
		k_work_init_delayable(&ui_test, ui_test_fn);
}


static void user_buzzer_init(void)
{
	int ret;
	double start_intensity = INTENSITY_START_VAL;

	ret = ui_buzzer_init();
	if (ret) {
		LOG_ERR("Init ui buzzer failed (%d)", ret);
	}

	ret = ui_buzzer_set_intensity(INTENSITY_START_VAL);
	if (ret) {
		LOG_ERR("Set buzzer intensity failed (%d)", ret);
	}

	ret = ui_buzzer_set_frequency(FREQUENCY_START_VAL);
	if (ret) {
		LOG_ERR("Set buzzer frequency failed (%d)", ret);
	}
}

static uint8_t calculate_intensity(uint8_t colour_value, uint8_t brightness_value)
{
	uint32_t numerator = (uint32_t)colour_value * brightness_value;
	uint32_t denominator = BRIGHTNESS_MAX;

	return (uint8_t)(numerator / denominator);
}

static void user_led_init(void)
{
	uint8_t intensity;
	int err;
	struct ui_rgb_control_color rgb_color;
	struct ui_rgb_control_effect rgb_effect;

	if (IS_ENABLED(CONFIG_UI_LED_USE_PWM)) {
		ui_led_pwm_init();
		for (int i = 0; i < NUM_LEDS; ++i) {
			colour_val[i] = UINT8_MAX;
			brightness_val[i] = BRIGHTNESS_MAX;
			intensity = calculate_intensity(colour_val[i], brightness_val[i]);
			ui_led_pwm_set_intensity(i, intensity);
		}
	} else if (IS_ENABLED(CONFIG_UI_LED_USE_GPIO)) {
		ui_led_gpio_init();
	}

	rgb_color.red = 0;
	rgb_color.green = 255;
	rgb_color.blue = 0;

	rgb_effect.type = UI_RGB_CONTROL_TYPE_CONTINUE;
	rgb_effect.interval = 2;
	rgb_effect.duty = 50;
	rgb_effect.duration = 0;
	
	err = ui_rgb_control_set(rgb_color,rgb_effect);
	if(err) {
		LOG_ERR("ui_rgb_control_set error");
	}
}

static void button_event_handler(uint32_t button_state, uint32_t has_changed)
{
	if (has_changed & button_state & DK_BTN1_MSK) {
		printk("Button 1 pressed\n");
	}
}
void main(void)
{
	int err;
	struct ui_rgb_control_color rgb_color;
	struct ui_rgb_control_effect rgb_effect;

	printk("Thing simple example start\n");

	work_init();

	user_work_init();

	user_led_init();

	user_buzzer_init();

	err = dk_buttons_init(button_event_handler);
	if (err) {
		LOG_ERR("Could not initialize buttons (%d)", err);
	}

#if defined(CONFIG_NRF_MODEM_LIB)

	/* Initialize the modem before calling configure_low_power(). This is
	 * because the enabling of RAI is dependent on the
	 * configured network mode which is set during modem initialization.
	 */
	modem_init();

	err = configure_low_power();
	if (err) {
		printk("Unable to set low power configuration, error: %d\n",
		       err);
	}

	modem_connect();

	k_sem_take(&lte_connected, K_FOREVER);
#endif

	rgb_color.red = 0;
	rgb_color.green = 255;
	rgb_color.blue = 0;

	rgb_effect.type = UI_RGB_CONTROL_TYPE_BLINKY;
	rgb_effect.interval = 2;
	rgb_effect.duty = 50;
	rgb_effect.duration = 0;
	
	err = ui_rgb_control_set(rgb_color,rgb_effect);
	if(err) {
		LOG_ERR("ui_rgb_control_set error");
	}

	printk("LTE connected\n");

	err = server_init();
	if (err) {
		printk("Not able to initialize UDP server connection\n");
		return;
	}

	err = server_connect();
	if (err) {
		printk("Not able to connect to UDP server\n");
		return;
	}

	k_work_schedule(&server_transmission_work, K_NO_WAIT);


}
```

## src/ui_buzzer_control.c
```c
/*
 * Copyright (c) 2020 Nordic Semiconductor ASA
 *
 * SPDX-License-Identifier: LicenseRef-Nordic-5-Clause
 */

#include <zephyr/kernel.h>
#include <stdio.h>
#include "ui_buzzer.h"
#include "ui_buzzer_control.h"

K_MSGQ_DEFINE(ui_buzzer_control_msgq, sizeof(ui_buzzer_control_message), 5, 4);

#define UI_BUZZER_CONTROL_WORK_Q_STACK_SIZE 512
#define UI_BUZZER_CONTROL_WORK_Q_PRIORITY      K_LOWEST_APPLICATION_THREAD_PRIO
K_THREAD_STACK_DEFINE(ui_buzzer_control_work_q_stack, UI_BUZZER_CONTROL_WORK_Q_STACK_SIZE);
static struct k_work_q ui_buzzer_control_work_q;

static struct k_work_delayable buzzer_open_dwork;
static struct k_work_delayable buzzer_close_dwork;
static struct k_work_delayable buzzer_set_color_dwork;
static struct k_work_delayable buzzer_interval_dwork;

/******* user ui effect thread *******/
#define UI_BUZZER_CONTROL_THREAD_STACK_SIZE 512
#define UI_BUZZER_CONTROL_THREAD_PRIORITY      K_LOWEST_APPLICATION_THREAD_PRIO - 1

static int16_t total_lift_span_cnt = 0;
static ui_buzzer_control_message message;

static void buzzer_open_dwork_fn(struct k_work *work)
{
    //printk("buzzer_open_dwork_fn\n");
    ui_buzzer_on_off(true);   
}

static void buzzer_close_dwork_fn(struct k_work *work)
{
    //printk("buzzer_close_dwork_fn\n");
    ui_buzzer_on_off(false); 
}

static void buzzer_set_color_dwork_fn(struct k_work *work)
{
    //printk("buzzer_set_color_dwork_fn\n");
	ui_buzzer_set_frequency(message.tone.frequency);
	ui_buzzer_set_intensity(message.tone.intensity); 
}

static void buzzer_interval_dwork_fn(struct k_work *work)
{
    //printk("buzzer_interval_dwork_fn\n");
    uint32_t duty_value;
    k_timeout_t delay_value;
   
    k_work_schedule_for_queue(&ui_buzzer_control_work_q, &buzzer_set_color_dwork, K_NO_WAIT);
    k_work_schedule_for_queue(&ui_buzzer_control_work_q, &buzzer_open_dwork, K_NO_WAIT);

    if(message.effect.interval > 5) {
        duty_value = (uint32_t)message.effect.interval * message.effect.duty;
        duty_value = duty_value / 100;
        delay_value = K_SECONDS(duty_value);
    }
    else {
        duty_value = (uint32_t)message.effect.interval * 1000 * message.effect.duty;
        duty_value = duty_value / 100;
        delay_value = K_MSEC(duty_value);       
    }

    k_work_schedule_for_queue(&ui_buzzer_control_work_q, &buzzer_close_dwork, delay_value);

    if(message.effect.duration > 0) {
        total_lift_span_cnt = total_lift_span_cnt - message.effect.interval;
        if(total_lift_span_cnt > 0) {
            k_work_schedule_for_queue(&ui_buzzer_control_work_q, &buzzer_interval_dwork, 
                                      K_SECONDS(message.effect.interval));
        }
        else {
            total_lift_span_cnt = 0;
        }
    }
    else {
        k_work_schedule_for_queue(&ui_buzzer_control_work_q, &buzzer_interval_dwork, 
                                  K_SECONDS(message.effect.interval));
    }    
}

static void ui_buzzer_control_task(void)
{
    struct k_work_sync sync;

    printk("ui_buzzer_control_task initial\n");
    k_work_queue_init(&ui_buzzer_control_work_q);
    k_work_queue_start(&ui_buzzer_control_work_q, ui_buzzer_control_work_q_stack,
                        K_THREAD_STACK_SIZEOF(ui_buzzer_control_work_q_stack), 
                        UI_BUZZER_CONTROL_WORK_Q_PRIORITY,
                        NULL);

    k_work_init_delayable(&buzzer_open_dwork, buzzer_open_dwork_fn);
    k_work_init_delayable(&buzzer_close_dwork, buzzer_close_dwork_fn);
    k_work_init_delayable(&buzzer_set_color_dwork, buzzer_set_color_dwork_fn);
    k_work_init_delayable(&buzzer_interval_dwork, buzzer_interval_dwork_fn);

	for (;;) {                                   
        k_msgq_get(&ui_buzzer_control_msgq, &message, K_FOREVER);
        printk("ui_buzzer_control_task get a message from msgq\n");
        k_work_cancel_delayable_sync(&buzzer_close_dwork, &sync);
        k_work_cancel_delayable_sync(&buzzer_interval_dwork, &sync);

        if(message.effect.type == UI_BUZZER_CONTROL_TYPE_CONTINUE){
            printk("message.effect.type == UI_BUZZER_CONTROL_TYPE_CONTINUE\n");
            k_work_schedule_for_queue(&ui_buzzer_control_work_q, &buzzer_set_color_dwork, K_NO_WAIT);
            k_work_schedule_for_queue(&ui_buzzer_control_work_q, &buzzer_open_dwork, K_NO_WAIT);
            if(message.effect.duration > 0) {
                k_work_schedule_for_queue(&ui_buzzer_control_work_q, &buzzer_close_dwork,
                                        K_SECONDS(message.effect.duration));
            }
        }
        else {
            printk("message.effect.type == UI_BUZZER_CONTROL_TYPE_BLINKY\n");
            total_lift_span_cnt = message.effect.duration;
            k_work_schedule_for_queue(&ui_buzzer_control_work_q, &buzzer_interval_dwork, K_NO_WAIT);
        }       
	}
}


K_THREAD_DEFINE(ui_buzzer_control_thread, 
                UI_BUZZER_CONTROL_THREAD_STACK_SIZE,
                ui_buzzer_control_task,
		        NULL, NULL, NULL,
                UI_BUZZER_CONTROL_THREAD_PRIORITY,
                0, 0);


/**
 * @brief set the buzzer effect 
 *
 * @return int 0 if successful, negative error code if not.
 */
int ui_buzzer_control_set(struct ui_buzzer_control_tone tone_in, struct ui_buzzer_control_effect effect_in)
{
    printk("ui_buzzer_control_set\n");
    int ret;
    ui_buzzer_control_message message;

    message.tone = tone_in;
    message.effect = effect_in;

    ret = k_msgq_put(&ui_buzzer_control_msgq, &message, K_NO_WAIT);

    return ret;
}
```

## src/ui_buzzer_control.h
```c
/*
 * Copyright (c) 2021 Nordic Semiconductor ASA
 *
 * SPDX-License-Identifier: LicenseRef-Nordic-5-Clause
 */
#ifndef UI_BUZZER_CONTROL_H__
#define UI_BUZZER_CONTROL_H__

#include <zephyr/kernel.h>

#ifdef __cplusplus
extern "C" {
#endif

#define UI_BUZZER_CONTROL_TYPE_CONTINUE      0
#define UI_BUZZER_CONTROL_TYPE_BLINKY   1


/** @brief A structure used to set the RBG LED color. */
struct ui_buzzer_control_tone {
	/* buzzer frequency value range 0~FREQUENCY_MAX. */
	uint32_t frequency;

	/* buzzer intensity range 0~INTENSITY_MAX. */
	uint8_t intensity;
};

struct ui_buzzer_control_effect {
	/* type of RGB led effect. */
	uint8_t type;

	/* blinkyg duty cycle 0-100. */
	uint8_t duty;

	/* blinky interval value Range: 0~255 Unit:second*/
	uint8_t interval;

	/* effect duration value range 0~255. 0=forever Unit:second*/
	uint8_t duration;
};

typedef struct {
    struct ui_buzzer_control_tone   tone;
    struct ui_buzzer_control_effect effect;
}__attribute__((aligned(4))) ui_buzzer_control_message;

/**
 * @brief set the buzzer effect 
 *
 * @return int 0 if successful, negative error code if not.
 */
int ui_buzzer_control_set(struct ui_buzzer_control_tone tone_in, struct ui_buzzer_control_effect effect_in);

#ifdef __cplusplus
}
#endif

#endif /* UI_BUZZER_CONTROL_H__ */
```

## src/ui_rgb_control.c
```c
/*
 * Copyright (c) 2020 Nordic Semiconductor ASA
 *
 * SPDX-License-Identifier: LicenseRef-Nordic-5-Clause
 */

#include <zephyr/kernel.h>
#include <stdio.h>
#include "ui_led.h"
#include "ui_rgb_control.h"

K_MSGQ_DEFINE(ui_rgb_control_msgq, sizeof(ui_rgb_control_message), 5, 4);

#define UI_RGB_CONTROL_WORK_Q_STACK_SIZE 512
#define UI_RGB_CONTROL_WORK_Q_PRIORITY      K_LOWEST_APPLICATION_THREAD_PRIO
K_THREAD_STACK_DEFINE(ui_rgb_control_work_q_stack, UI_RGB_CONTROL_WORK_Q_STACK_SIZE);
static struct k_work_q ui_rgb_control_work_q;

static struct k_work_delayable rgb_open_dwork;
static struct k_work_delayable rgb_close_dwork;
static struct k_work_delayable rgb_set_color_dwork;
static struct k_work_delayable rgb_interval_dwork;

/******* user ui effect thread *******/
#define UI_RGB_CONTROL_THREAD_STACK_SIZE 512
#define UI_RGB_CONTROL_THREAD_PRIORITY      K_LOWEST_APPLICATION_THREAD_PRIO - 1

static int16_t total_lift_span_cnt = 0;
static ui_rgb_control_message message;

static void rgb_open_dwork_fn(struct k_work *work)
{
    //printk("rgb_open_dwork_fn\n");
    ui_led_pwm_on_off(0, true); 
	ui_led_pwm_on_off(1, true);
	ui_led_pwm_on_off(2, true);    
}

static void rgb_close_dwork_fn(struct k_work *work)
{
    //printk("rgb_close_dwork_fn\n");
    ui_led_pwm_on_off(0, false); 
	ui_led_pwm_on_off(1, false);
	ui_led_pwm_on_off(2, false);    
}

static void rgb_set_color_dwork_fn(struct k_work *work)
{
    //printk("rgb_set_color_dwork_fn\n");
	ui_led_pwm_set_intensity(0, message.color.red);     /*Red*/
	ui_led_pwm_set_intensity(1, message.color.green);   /*Green*/
	ui_led_pwm_set_intensity(2, message.color.blue);    /*Blue*/	
}

static void rgb_interval_dwork_fn(struct k_work *work)
{
    //printk("rgb_interval_dwork_fn\n");
    uint32_t duty_value;
    k_timeout_t delay_value;
   
    k_work_schedule_for_queue(&ui_rgb_control_work_q, &rgb_set_color_dwork, K_NO_WAIT);
    k_work_schedule_for_queue(&ui_rgb_control_work_q, &rgb_open_dwork, K_NO_WAIT);

    if(message.effect.interval > 5) {
        duty_value = (uint32_t)message.effect.interval * message.effect.duty;
        duty_value = duty_value / 100;
        delay_value = K_SECONDS(duty_value);
    }
    else {
        duty_value = (uint32_t)message.effect.interval * 1000 * message.effect.duty;
        duty_value = duty_value / 100;
        delay_value = K_MSEC(duty_value);       
    }

    k_work_schedule_for_queue(&ui_rgb_control_work_q, &rgb_close_dwork, delay_value);

    if(message.effect.duration > 0) {
        total_lift_span_cnt = total_lift_span_cnt - message.effect.interval;
        if(total_lift_span_cnt > 0) {
            k_work_schedule_for_queue(&ui_rgb_control_work_q, &rgb_interval_dwork, 
                                      K_SECONDS(message.effect.interval));
        }
        else {
            total_lift_span_cnt = 0;
        }
    }
    else {
        k_work_schedule_for_queue(&ui_rgb_control_work_q, &rgb_interval_dwork, 
                                  K_SECONDS(message.effect.interval));
    }    
}

static void ui_rgb_control_task(void)
{
    struct k_work_sync sync;

    printk("ui_rgb_control_task initial\n");
    k_work_queue_init(&ui_rgb_control_work_q);
    k_work_queue_start(&ui_rgb_control_work_q, ui_rgb_control_work_q_stack,
                        K_THREAD_STACK_SIZEOF(ui_rgb_control_work_q_stack), 
                        UI_RGB_CONTROL_WORK_Q_PRIORITY,
                        NULL);

    k_work_init_delayable(&rgb_open_dwork, rgb_open_dwork_fn);
    k_work_init_delayable(&rgb_close_dwork, rgb_close_dwork_fn);
    k_work_init_delayable(&rgb_set_color_dwork, rgb_set_color_dwork_fn);
    k_work_init_delayable(&rgb_interval_dwork, rgb_interval_dwork_fn);

	for (;;) {                                   
        k_msgq_get(&ui_rgb_control_msgq, &message, K_FOREVER);
        printk("ui_rgb_control_task get a message from msgq\n");
        k_work_cancel_delayable_sync(&rgb_close_dwork, &sync);
        k_work_cancel_delayable_sync(&rgb_interval_dwork, &sync);

        if(message.effect.type == UI_RGB_CONTROL_TYPE_CONTINUE){
            printk("message.effect.type == UI_RGB_CONTROL_TYPE_CONTINUE\n");
            k_work_schedule_for_queue(&ui_rgb_control_work_q, &rgb_set_color_dwork, K_NO_WAIT);
            k_work_schedule_for_queue(&ui_rgb_control_work_q, &rgb_open_dwork, K_NO_WAIT);
            if(message.effect.duration > 0) {
                k_work_schedule_for_queue(&ui_rgb_control_work_q, &rgb_close_dwork,
                                        K_SECONDS(message.effect.duration));
            }
        }
        else {
            printk("message.effect.type == UI_RGB_CONTROL_TYPE_BLINKY\n");
            total_lift_span_cnt = message.effect.duration;
            k_work_schedule_for_queue(&ui_rgb_control_work_q, &rgb_interval_dwork, K_NO_WAIT);
        }          
	}
}


K_THREAD_DEFINE(ui_rgb_control_thread, 
                UI_RGB_CONTROL_THREAD_STACK_SIZE,
                ui_rgb_control_task,
		        NULL, NULL, NULL,
                UI_RGB_CONTROL_THREAD_PRIORITY,
                0, 0);


/**
 * @brief set the RBG LED effect 
 *
 * @return int 0 if successful, negative error code if not.
 */
int ui_rgb_control_set(struct ui_rgb_control_color color_in, struct ui_rgb_control_effect effect_in)
{
    printk("user_ui_effect_rgb_set\n");
    int ret;
    ui_rgb_control_message message;

    message.color = color_in;
    message.effect = effect_in;

    ret = k_msgq_put(&ui_rgb_control_msgq, &message, K_NO_WAIT);

    return ret;
}
```

## src/ui_rgb_control.h
```c
/*
 * Copyright (c) 2021 Nordic Semiconductor ASA
 *
 * SPDX-License-Identifier: LicenseRef-Nordic-5-Clause
 */
#ifndef UI_RGB_CONTROL_H__
#define UI_RGB_CONTROL_H__

#include <zephyr/kernel.h>

#ifdef __cplusplus
extern "C" {
#endif

#define UI_RGB_CONTROL_TYPE_CONTINUE      0
#define UI_RGB_CONTROL_TYPE_BLINKY        1


/** @brief A structure used to set the RBG LED color. */
struct ui_rgb_control_color {
	/* Red value range 0~255. */
	uint8_t red;

	/* Green value range 0~255. */
	uint8_t green;

	/* Blue value range 0~255. */
	uint8_t blue;
};

struct ui_rgb_control_effect {
	/* type of RGB led effect. */
	uint8_t type;

	/* blinkyg duty cycle 0-100. */
	uint8_t duty;

	/* blinky interval value Range: 0~255 Unit:second*/
	uint8_t interval;

	/* effect duration value range 0~255. 0=forever Unit:second*/
	uint8_t duration;
};

typedef struct {
    struct ui_rgb_control_color  color;
    struct ui_rgb_control_effect effect;
}__attribute__((aligned(4))) ui_rgb_control_message;

/**
 * @brief set the RBG LED effect 
 *
 * @return int 0 if successful, negative error code if not.
 */
int ui_rgb_control_set(struct ui_rgb_control_color color, struct ui_rgb_control_effect effect);

#ifdef __cplusplus
}
#endif

#endif /* UI_RGB_CONTROL_H__ */
```

## src/user_shell_cmd.c
```c
/*
 * Copyright (c) 2020 Nordic Semiconductor ASA
 *
 * SPDX-License-Identifier: LicenseRef-Nordic-5-Clause
 */

#include <zephyr/kernel.h>
#include <stdio.h>
#include <zephyr/shell/shell.h>

#include "ui_rgb_control.h"
#include "ui_buzzer_control.h"
#include "ui_buzzer.h"
#include "user_shell_cmd.h"

static int cmd_gnss(const struct shell *shell, size_t argc,
                         char **argv)
{
	int cnt;
	shell_print(shell, "cmd_gnss argc = %d", argc);
	for (cnt = 0; cnt < argc; cnt++) {
			shell_print(shell, "cmd_gnss argv[%d] = %s", cnt, argv[cnt]);
	}
	return 0;
}

static int cmd_fftt(const struct shell *shell, size_t argc,
                           char **argv)
{
	int cnt;
	shell_print(shell, "cmd_fftt argc = %d", argc);
	for (cnt = 0; cnt < argc; cnt++) {
			shell_print(shell, "cmd_fftt argv[%d] = %s", cnt, argv[cnt]);
	}
	return 0;
}

static int cmd_rgb(const struct shell *shell, size_t argc,
                           char **argv)
{
	int cnt;
	int ret;
	struct ui_rgb_control_color rgb_color;
	struct ui_rgb_control_effect rgb_effect;
	uint32_t arg_val;
	uint16_t arg_flag = 0;
	uint8_t arg_opt_flag = 2;

	for (cnt = 0; cnt < argc; cnt++) {
			switch(cnt)
			{
				case CMD_RGB_ARG_RED:
					arg_val = strtol(argv[cnt], NULL, 10);
					if((arg_val >= 0) && (arg_val <= 255)) {
						rgb_color.red = arg_val;
					}
					else {
						arg_flag = cnt;
					}					
					break;
				case CMD_RGB_ARG_GREEN:
					arg_val = strtol(argv[cnt], NULL, 10);
					if((arg_val >= 0) && (arg_val <= 255)) {
						rgb_color.green = arg_val;
					}
					else {
						arg_flag = cnt; 
					}	
					break;
				case CMD_RGB_ARG_BLUE:
					arg_val = strtol(argv[cnt], NULL, 10);
					if((arg_val >= 0) && (arg_val <= 255)) {
						rgb_color.blue = arg_val;
					}
					else {
						arg_flag = cnt; 
					}	
					break;
				case CMD_RGB_ARG_TYPE:
					arg_val = strtol(argv[cnt], NULL, 10);
					if((arg_val >= 0) && (arg_val <= 1)) {
						rgb_effect.type = arg_val;
					}
					else {
						arg_flag = cnt; 
					}					
					break;
				case CMD_RGB_ARG_DURATION:
					arg_val = strtol(argv[cnt], NULL, 10);
					if((arg_val >= 0) && (arg_val <= 255)) {
						rgb_effect.duration = arg_val;
					}
					else {
						arg_flag = cnt; 
					}					
					break;				
				case CMD_RGB_ARG_INTERVAL:
					arg_val = strtol(argv[cnt], NULL, 10);
					if((arg_val >= 0) && (arg_val <= 255)) {
						rgb_effect.interval = arg_val;
						arg_opt_flag = arg_opt_flag - 1;
					}
					else {
						arg_flag = cnt; 
					}				
					break;
				case CMD_RGB_ARG_DUTYCYCLE:
					arg_val = strtol(argv[cnt], NULL, 10);
					if((arg_val >= 0) && (arg_val < 100)) {
						rgb_effect.duty = arg_val;
						arg_opt_flag = arg_opt_flag - 1;
					}
					else {
						arg_flag = cnt; 
					}					
					break;															
				default:
					break;															
			}
	}

	if(rgb_effect.type == UI_RGB_CONTROL_TYPE_BLINKY) {
		if(arg_opt_flag != 0) {
			arg_flag = 1001;
		}
	}
	if(arg_flag == 0) {
		ret = ui_rgb_control_set(rgb_color,rgb_effect);
		if(ret) {
			shell_print(shell, "cmd_rgb excute fail due to ui_rgb_control_set retrun: %d", ret);
		}
		else {
			shell_print(shell, "cmd_rgb excute success");
		}	
	}
	else {
		shell_print(shell, "cmd_rgb excute fail due to wrong arg : %d", arg_flag);
	}

	return 0;
}


static int cmd_buzzer(const struct shell *shell, size_t argc, char **argv)
{
	int cnt;
	int ret;
	struct ui_buzzer_control_tone buzzer_tone;
	struct ui_buzzer_control_effect buzzer_effect;
	uint32_t arg_val;
	uint16_t arg_flag = 0;
	uint8_t arg_opt_flag = 2;

	for (cnt = 0; cnt < argc; cnt++) {
			switch(cnt)
			{
				case CMD_BUZZER_ARG_FREQUENCY:
					arg_val = strtol(argv[cnt], NULL, 10);
					if((arg_val >= 0) && (arg_val <= CMD_BUZZER_ARG_FREQUENCY_MAX)) {
						buzzer_tone.frequency = arg_val;
					}
					else {
						arg_flag = cnt;
					}					
					break;
				case CMD_BUZZER_ARG_INTENSITY:
					arg_val = strtol(argv[cnt], NULL, 10);
					if((arg_val >= 0) && (arg_val <= CMD_BUZZER_ARG_INTENSITY_MAX)) {
						buzzer_tone.intensity = arg_val;
					}
					else {
						arg_flag = cnt; 
					}	
					break;

				case CMD_BUZZER_ARG_TYPE:
					arg_val = strtol(argv[cnt], NULL, 10);
					if((arg_val >= 0) && (arg_val <= 1)) {
						buzzer_effect.type = arg_val;
					}
					else {
						arg_flag = cnt; 
					}					
					break;
				case CMD_BUZZER_ARG_DURATION:
					arg_val = strtol(argv[cnt], NULL, 10);
					if((arg_val >= 0) && (arg_val <= 255)) {
						buzzer_effect.duration = arg_val;
					}
					else {
						arg_flag = cnt; 
					}					
					break;				
				case CMD_BUZZER_ARG_INTERVAL:
					arg_val = strtol(argv[cnt], NULL, 10);
					if((arg_val >= 0) && (arg_val <= 255)) {
						buzzer_effect.interval = arg_val;
						arg_opt_flag = arg_opt_flag - 1;
					}
					else {
						arg_flag = cnt; 
					}				
					break;
				case CMD_BUZZER_ARG_DUTYCYCLE:
					arg_val = strtol(argv[cnt], NULL, 10);
					if((arg_val >= 0) && (arg_val < 100)) {
						buzzer_effect.duty = arg_val;
						arg_opt_flag = arg_opt_flag - 1;
					}
					else {
						arg_flag = cnt; 
					}					
					break;															
				default:
					break;															
			}
	}
	
	if(buzzer_effect.type == UI_BUZZER_CONTROL_TYPE_BLINKY) {
		if(arg_opt_flag != 0) {
			arg_flag = 1001;
		}
	}
	if(arg_flag == 0) {
		ret = ui_buzzer_control_set(buzzer_tone, buzzer_effect);
		if(ret) {
			shell_print(shell, "cmd_buzzer excute fail due to ui_buzzer_control_set retrun: %d", ret);
		}
		else {
			shell_print(shell, "cmd_buzzer excute success");
		}	
	}
	else {
		shell_print(shell, "cmd_buzzer excute fail due to wrong arg : %d", arg_flag);
	}

	return 0;
}

SHELL_STATIC_SUBCMD_SET_CREATE(sub_thingy,
        SHELL_CMD(gnss, NULL, "Start gnss test", cmd_gnss),
        SHELL_CMD(fftt, NULL, "Start first fix time test.", cmd_fftt),
		SHELL_CMD_ARG(rgb, NULL, "rgb led control", cmd_rgb, 6, 2),
		SHELL_CMD_ARG(buzzer, NULL, "buzzer control", cmd_buzzer, 5, 2),
        SHELL_SUBCMD_SET_END
);
/* Creating root (level 0) command "demo" without a handler */
SHELL_CMD_REGISTER(thingy, &sub_thingy, "Thingy 91 command line interface", NULL);
```

## src/user_shell_cmd.h
```c
#ifndef UER_SEHLL_CMD_H__
#define UER_SEHLL_CMD_H__

#include <zephyr/kernel.h>

#ifdef __cplusplus
extern "C" {
#endif

#define CMD_RGB_ARG_RED        1
#define CMD_RGB_ARG_GREEN      2
#define CMD_RGB_ARG_BLUE       3
#define CMD_RGB_ARG_TYPE       4
#define CMD_RGB_ARG_DURATION   5
#define CMD_RGB_ARG_INTERVAL   6
#define CMD_RGB_ARG_DUTYCYCLE  7


#define CMD_BUZZER_ARG_FREQUENCY  1
#define CMD_BUZZER_ARG_INTENSITY  2
#define CMD_BUZZER_ARG_TYPE       3
#define CMD_BUZZER_ARG_DURATION   4
#define CMD_BUZZER_ARG_INTERVAL   5
#define CMD_BUZZER_ARG_DUTYCYCLE  6

#define CMD_BUZZER_ARG_FREQUENCY_MAX 10000
#define CMD_BUZZER_ARG_INTENSITY_MAX 100

#ifdef __cplusplus
}
#endif

#endif /* UER_SHELL_CMD_H__ */
```

## src/user_ui_effect.c
```c
/*
 * Copyright (c) 2020 Nordic Semiconductor ASA
 *
 * SPDX-License-Identifier: LicenseRef-Nordic-5-Clause
 */

#include <zephyr/kernel.h>
#include <stdio.h>
#include "ui_led.h"
#include "ui_buzzer.h"
#include "user_ui_effect.h"

K_MSGQ_DEFINE(user_ui_msgq, sizeof(user_ui_message), 10, 4);

#define USER_UI_WORK_Q_STACK_SIZE 1024
#define USER_UI_WORK_Q_PRIORITY      K_LOWEST_APPLICATION_THREAD_PRIO
K_THREAD_STACK_DEFINE(user_ui_work_q_stack, USER_UI_WORK_Q_STACK_SIZE);
static struct k_work_q user_ui_work_q;

static struct k_work_delayable rgb_open_dwork;
static struct k_work_delayable rgb_close_dwork;
static struct k_work_delayable rgb_set_color_dwork;
static struct k_work_delayable rgb_interval_dwork;

/******* user ui effect thread *******/
#define USER_UI_THREAD_STACK_SIZE 1024
#define USER_UI_THREAD_PRIORITY      K_LOWEST_APPLICATION_THREAD_PRIO - 1

int16_t total_lift_span_cnt = 0;
static user_ui_message message;

static void rgb_open_dwork_fn(struct k_work *work)
{
    //printk("rgb_open_dwork_fn\n");
    ui_led_pwm_on_off(0, true); 
	ui_led_pwm_on_off(1, true);
	ui_led_pwm_on_off(2, true);    
}

static void rgb_close_dwork_fn(struct k_work *work)
{
    //printk("rgb_close_dwork_fn\n");
    ui_led_pwm_on_off(0, false); 
	ui_led_pwm_on_off(1, false);
	ui_led_pwm_on_off(2, false);    
}

static void rgb_set_color_dwork_fn(struct k_work *work)
{
    //printk("rgb_set_color_dwork_fn\n");
	ui_led_pwm_set_intensity(0, message.color.red);     /*Red*/
	ui_led_pwm_set_intensity(1, message.color.green);   /*Green*/
	ui_led_pwm_set_intensity(2, message.color.blue);    /*Blue*/	
}

static void rgb_interval_dwork_fn(struct k_work *work)
{
    //printk("rgb_interval_dwork_fn\n");
    uint32_t duty_value;
    k_timeout_t delay_value;
    //struct user_ui_message *message = CONTAINER_OF(work, struct user_ui_message, work);
    k_work_schedule_for_queue(&user_ui_work_q, &rgb_set_color_dwork, K_NO_WAIT);
    k_work_schedule_for_queue(&user_ui_work_q, &rgb_open_dwork, K_NO_WAIT);

    if(message.effect.interval > 5) {
        duty_value = (uint32_t)message.effect.interval * message.effect.duty;
        duty_value = duty_value / 100;
        delay_value = K_SECONDS(duty_value);
    }
    else {
        duty_value = (uint32_t)message.effect.interval * 1000 * message.effect.duty;
        duty_value = duty_value / 100;
        delay_value = K_MSEC(duty_value);       
    }

    k_work_schedule_for_queue(&user_ui_work_q, &rgb_close_dwork, delay_value);

    if(message.effect.duration > 0) {
        total_lift_span_cnt = total_lift_span_cnt - message.effect.interval;
        if(total_lift_span_cnt > 0) {
            k_work_schedule_for_queue(&user_ui_work_q, &rgb_interval_dwork, 
                                      K_SECONDS(message.effect.interval));
        }
        else {
            total_lift_span_cnt = 0;
        }
    }
    else {
        k_work_schedule_for_queue(&user_ui_work_q, &rgb_interval_dwork, 
                                  K_SECONDS(message.effect.interval));
    }    
}

void user_ui_effect_task(void)
{
    struct k_work_sync sync;

    printk("user_ui_effect_task initial\n");
    k_work_queue_init(&user_ui_work_q);
    k_work_queue_start(&user_ui_work_q, user_ui_work_q_stack,
                        K_THREAD_STACK_SIZEOF(user_ui_work_q_stack), USER_UI_WORK_Q_PRIORITY,
                        NULL);

    k_work_init_delayable(&rgb_open_dwork, rgb_open_dwork_fn);
    k_work_init_delayable(&rgb_close_dwork, rgb_close_dwork_fn);
    k_work_init_delayable(&rgb_set_color_dwork, rgb_set_color_dwork_fn);
    k_work_init_delayable(&rgb_interval_dwork, rgb_interval_dwork_fn);

	for (;;) {                                   
        k_msgq_get(&user_ui_msgq, &message, K_FOREVER);
        printk("user_ui_effect_task get a message from msgq\n");
        k_work_cancel_delayable_sync(&rgb_close_dwork, &sync);
        k_work_cancel_delayable_sync(&rgb_interval_dwork, &sync);

        if(message.effect.type == USER_UI_EFFECT_RGB_TYPE_CONTINUE){
            printk("message.effect.type == USER_UI_EFFECT_RGB_TYPE_CONTINUE\n");
            k_work_schedule_for_queue(&user_ui_work_q, &rgb_set_color_dwork, K_NO_WAIT);
            k_work_schedule_for_queue(&user_ui_work_q, &rgb_open_dwork, K_NO_WAIT);
            if(message.effect.duration > 0) {
                k_work_schedule_for_queue(&user_ui_work_q, &rgb_close_dwork,
                                        K_SECONDS(message.effect.duration));
            }
        }
        else {
            printk("message.effect.type == USER_UI_EFFECT_RGB_TYPE_BLINKY\n");
            total_lift_span_cnt = message.effect.duration;
            k_work_schedule_for_queue(&user_ui_work_q, &rgb_interval_dwork, K_NO_WAIT);
        }
        
        printk("user_ui_effect_task get message from user app\n");            
	}
}


K_THREAD_DEFINE(user_ui_thread, 
                USER_UI_THREAD_STACK_SIZE,
                user_ui_effect_task,
		        NULL, NULL, NULL,
                USER_UI_THREAD_PRIORITY,
                0, 0);


/**
 * @brief set the RBG LED effect 
 *
 * @return int 0 if successful, negative error code if not.
 */
int user_ui_effect_rgb_set(struct user_ui_color color_in, struct user_ui_effect effect_in)
{
    printk("user_ui_effect_rgb_set\n");
    int ret;
    user_ui_message message;

    message.color = color_in;
    message.effect = effect_in;

    ret = k_msgq_put(&user_ui_msgq, &message, K_NO_WAIT);

    return ret;
}
```

## src/user_ui_effect.h
```c
/*
 * Copyright (c) 2021 Nordic Semiconductor ASA
 *
 * SPDX-License-Identifier: LicenseRef-Nordic-5-Clause
 */
#ifndef UER_UI_EFFECT_H__
#define UER_UI_EFFECT_H__

#include <zephyr/kernel.h>

#ifdef __cplusplus
extern "C" {
#endif

#define USER_UI_EFFECT_RGB_TYPE_CONTINUE      0
#define USER_UI_EFFECT_RGB_TYPE_BLINKY        1


/** @brief A structure used to set the RBG LED color. */
struct user_ui_color {
	/* Red value range 0~255. */
	uint8_t red;

	/* Green value range 0~255. */
	uint8_t green;

	/* Blue value range 0~255. */
	uint8_t blue;
};

struct user_ui_effect {
	/* type of RGB led effect. */
	uint8_t type;

	/* blinkyg duty cycle 0-100. */
	uint8_t duty;

	/* blinky interval value Range: 0~255 Unit:second*/
	uint8_t interval;

	/* effect duration value range 0~255. 0=forever Unit:second*/
	uint8_t duration;
};

typedef struct {
    struct user_ui_color  color;
    struct user_ui_effect effect;
}__attribute__((aligned(4))) user_ui_message;

/**
 * @brief set the RBG LED effect 
 *
 * @return int 0 if successful, negative error code if not.
 */
int user_ui_effect_rgb_set(struct user_ui_color color, struct user_ui_effect effect);

#ifdef __cplusplus
}
#endif

#endif /* UI_INPUT_H__ */
```
